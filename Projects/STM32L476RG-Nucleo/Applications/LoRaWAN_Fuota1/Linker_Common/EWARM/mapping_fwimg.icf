/*###ICF### Set of symbols used in SE and SB_SFU projects ****/

/* Slots Regions must be aligned on 2048 bytes (0x800) */

/* swap region (8 kbytes) */
define exported symbol  __ICFEDIT_region_SWAP_start__  = 0x080F0000;
define exported symbol  __ICFEDIT_region_SWAP_end__    = 0x080F1FFF;

/* slot 0 region (424 kbytes) */
define exported symbol  __ICFEDIT_region_SLOT_0_start__= 0x08086000;
define exported symbol  __ICFEDIT_region_SLOT_0_end__  = 0x080EFFFF;

/* slot 1 region (424 kbytes) */
define exported symbol  __ICFEDIT_region_SLOT_1_start__= 0x08014000;
define exported symbol  __ICFEDIT_region_SLOT_1_end__  = 0x0807Dfff;

/* firmware images regions definition */
define region SWAP_region   = mem:[from __ICFEDIT_region_SWAP_start__ to __ICFEDIT_region_SWAP_end__];
define region SLOT_0_region = mem:[from __ICFEDIT_region_SLOT_0_start__ to __ICFEDIT_region_SLOT_0_end__];
define region SLOT_1_region = mem:[from __ICFEDIT_region_SLOT_1_start__ to __ICFEDIT_region_SLOT_1_end__];
